//
// RTC_LCD_Clock : RTC update a clock on LCD
//
// EVB : Nu-LB-NUC140
// MCU : NUC140VE3CN
#include <stdio.h>
#include <math.h>
#include "NUC100Series.h"
#include "MCU_init.h"
#include "SYS_init.h"
#include "LCD.h"
#include "Draw2D.h"

#define PI 3.1415926
#define X0 64
#define Y0 32
#define R  20

volatile uint8_t old_x, old_y, new_x, new_y;

unsigned char bmp_Clock[64*8]= 
{
	0x00,0x00,0x00,0x00,0x00,0x00,0x00,0x00,0x00,0x00,0x00,0x80,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0x00,
	0x00,0x00,0x00,0x00,0x00,0xC0,0x60,0x38,0x0C,0x06,0x03,0x01,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0x00,
	0x00,0xC0,0xF0,0x1E,0x03,0x01,0x02,0x3F,0x00,0x24,0x22,0x21,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0x00,
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	0x00,0x00,0x00,0x00,0x00,0x00,0x00,0x00,0x00,0x00,0x00,0x01,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0x00
};

uint8_t RTC_Flag;
uint16_t theta;	

void RTC_IRQHandler(void)
{
	S_RTC_TIME_DATA_T sCurTime;
    RTC_GetDateAndTime(&sCurTime);	// get current time
    theta = sCurTime.u32Second *6;

    //------------drawing clock pointer---------------
    if (theta>=360) theta=0;
	
    new_x = X0 - (R-2) * cos(theta * PI/180);
    new_y = Y0 - (R-2) * sin(theta * PI/180);
	
    draw_Line(old_x,old_y,X0,Y0,BG_COLOR, BG_COLOR);
    draw_Line(new_x,new_y,X0,Y0,FG_COLOR, BG_COLOR);
	
    old_x = new_x;
    old_y = new_y;	
    //------------------------------------------------

    RTC_CLEAR_TICK_INT_FLAG();	
}

void Delay(uint32_t ucnt)
{
    volatile uint32_t i = ucnt;
    while (i--);
}

void Init_RTC(void)
{
  S_RTC_TIME_DATA_T sInitTime;

    // Time Setting
    sInitTime.u32Year       = 2015;
    sInitTime.u32Month      = 11;
    sInitTime.u32Day        = 29;
    sInitTime.u32Hour       = 9;
    sInitTime.u32Minute     = 15;
    sInitTime.u32Second     = 0;
    sInitTime.u32DayOfWeek  = RTC_SUNDAY;
    sInitTime.u32TimeScale  = RTC_CLOCK_24;

    RTC_Open(&sInitTime);
    RTC_SetTickPeriod(RTC_TICK_1_SEC);
    RTC_EnableInt(RTC_RIER_TIER_Msk);
    NVIC_EnableIRQ(RTC_IRQn);		  
}

int32_t main(void)
{
    SYS_Init();

    init_LCD();
    clear_LCD();
	
    draw_Bmp64x64(32, 0, FG_COLOR, BG_COLOR, bmp_Clock);
	
    old_x = X0 - (R-2) * cos(59*6 * PI/180);
    old_y = Y0 - (R-2) * sin(59*6 * PI/180);

    Init_RTC();

    while(1);
}
