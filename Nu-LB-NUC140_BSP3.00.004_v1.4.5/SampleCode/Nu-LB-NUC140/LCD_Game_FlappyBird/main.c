//
// LCD_Game_FlappyBird : emulate FlappyBird game on LCD
//
// EVB : Nu-LB-NUC140
// MCU : NUC140VE3CN
//
#include <stdio.h>
#include <string.h>
#include <math.h>
#include "NUC100Series.h"
#include "MCU_init.h"
#include "SYS_init.h"
#include "LCD.h"
#include "Scankey.h"

#define Bird_Xsize  16
#define Bird_Ysize  16
#define Tower_Xsize 16

// Tower Type 
// 0 : none
// 1,2,3,4 : Tower D1,D2,D3,D4
// 5,6,7,8 : Tower U1,U2,U3,U4

// bitmap is in upside down order
unsigned char bmp_Bird[16*2] = {
	0xF8,0x08,0x08,0x08,0x1C,0x34,0xE4,0x04,0x74,0x9C,0x6C,0x6C,0xE8,0xF8,0xF0,0xC0,
	0x00,0x07,0x0E,0x1A,0x33,0x21,0x20,0x2E,0x3A,0x33,0x35,0x29,0x2B,0x3A,0x1F,0x0D
};
unsigned char bmp_TowerD4[16*2] = { // 16x16
	0x01,0x03,0xFF,0xFF,0xFF,0xFF,0xFF,0xFF,0xE7,0xE7,0xE5,0xFD,0xFD,0xFF,0x03,0x01,
	0x00,0x00,0xFF,0xFF,0xFF,0xFF,0xFF,0xFF,0xFF,0xFF,0xFF,0xFF,0xFF,0xFF,0x00,0x00
};
unsigned char bmp_TowerD3[16*4] = { // 16x24
	0x01,0x03,0xFF,0xFF,0x3F,0x3F,0x3F,0x3F,0x27,0x27,0x25,0x3D,0xFD,0xFF,0x03,0x01,
	0x00,0x00,0xFF,0xFF,0xC0,0xC0,0xC0,0xC0,0xC0,0xC0,0xC0,0xC0,0xFF,0xFF,0x00,0x00,
	0x00,0x00,0xFF,0xFF,0xFF,0xFF,0xFF,0xFF,0xFF,0xFF,0xFF,0xFF,0xFF,0xFF,0x00,0x00
};
unsigned char bmp_TowerD2[16*4] = { // 16x32
	0x01,0x03,0xFF,0xFF,0x3F,0x3F,0x3F,0x3F,0x27,0x27,0x25,0x3D,0xFD,0xFF,0x03,0x01,
	0x00,0x00,0xFF,0xFF,0xC0,0xC0,0xC0,0xC0,0xC0,0xC0,0xC0,0xC0,0xFF,0xFF,0x00,0x00,
	0x00,0x00,0xFF,0xFF,0x01,0x01,0x01,0x01,0x01,0x01,0x01,0x01,0xFF,0xFF,0x00,0x00,
	0x00,0x00,0xFF,0xFF,0xFF,0xFF,0xFF,0xFF,0xFF,0xFF,0xFF,0xFF,0xFF,0xFF,0x00,0x00
};
unsigned char bmp_TowerD1[16*5] = { // 16x40
	0x01,0x03,0xFF,0xFF,0x7F,0x7F,0x7F,0x7F,0x67,0x67,0x65,0x7D,0xFD,0xFF,0x03,0x01,
	0x00,0x00,0xFF,0xFF,0xD5,0xD5,0xD5,0xD5,0xD5,0xD5,0xD5,0xD5,0xFF,0xFF,0x00,0x00,
	0x00,0x00,0xFF,0xFF,0x55,0x55,0x55,0x55,0x55,0x55,0x55,0x55,0xFF,0xFF,0x00,0x00,
	0x00,0x00,0xFF,0xFF,0x57,0x57,0x57,0x57,0x57,0x57,0x57,0x57,0xFF,0xFF,0x00,0x00,
	0x00,0x00,0xFF,0xFF,0xFF,0xFF,0xFF,0xFF,0xFF,0xFF,0xFF,0xFF,0xFF,0xFF,0x00,0x00
};
unsigned char bmp_TowerU1[16*2] = { // 16x16
	0x00,0x00,0xFF,0xFF,0xFF,0xFF,0xFF,0xFF,0xFF,0xFF,0xFF,0xFF,0xFF,0xFF,0x00,0x00,
	0x80,0xC0,0xFF,0xFF,0xFF,0xFF,0xFF,0xFF,0xE7,0xE7,0xA7,0xBF,0xBF,0xFF,0xC0,0x80
};
unsigned char bmp_TowerU2[16*3] = { // 16x24
	0x00,0x00,0xFF,0xFF,0xFF,0xFF,0xFF,0xFF,0xFF,0xFF,0xFF,0xFF,0xFF,0xFF,0x00,0x00,
	0x00,0x00,0xFF,0xFF,0x03,0x03,0x03,0x03,0x03,0x03,0x03,0x03,0xFF,0xFF,0x00,0x00,
	0x80,0xC0,0xFF,0xFF,0xFC,0xFC,0xFC,0xFC,0xE4,0xE4,0xA4,0xBC,0xBF,0xFF,0xC0,0x80
};
unsigned char bmp_TowerU3[16*4] = { // 16x32
	0x00,0x00,0xFF,0xFF,0xFF,0xFF,0xFF,0xFF,0xFF,0xFF,0xFF,0xFF,0xFF,0xFF,0x00,0x00,
	0x00,0x00,0xFF,0xFF,0x80,0x80,0x80,0x80,0x80,0x80,0x80,0x80,0xFF,0xFF,0x00,0x00,
	0x00,0x00,0xFF,0xFF,0x03,0x03,0x03,0x03,0x03,0x03,0x03,0x03,0xFF,0xFF,0x00,0x00,
	0x80,0xC0,0xFF,0xFF,0xFC,0xFC,0xFC,0xFC,0xE4,0xE4,0xA4,0xBC,0xBF,0xFF,0xC0,0x80
};
unsigned char bmp_TowerU4[16*5] = { // 16x40
	0x00,0x00,0xFF,0xFF,0xFF,0xFF,0xFF,0xFF,0xFF,0xFF,0xFF,0xFF,0xFF,0xFF,0x00,0x00,
	0x00,0x00,0xFF,0xFF,0xEA,0xEA,0xEA,0xEA,0xEA,0xEA,0xEA,0xEA,0xFF,0xFF,0x00,0x00,
	0x00,0x00,0xFF,0xFF,0xAA,0xAA,0xAA,0xAA,0xAA,0xAA,0xAA,0xAA,0xFF,0xFF,0x00,0x00,
	0x00,0x00,0xFF,0xFF,0xAB,0xAB,0xAB,0xAB,0xAB,0xAB,0xAB,0xAB,0xFF,0xFF,0x00,0x00,
	0x80,0xC0,0xFF,0xFF,0xFE,0xFE,0xFE,0xFE,0xE6,0xE6,0xA6,0xBE,0xBF,0xFF,0xC0,0x80
};
unsigned char GameTitle[128*8] ={
	0x00,0x00,0x00,0x00,0x00,0x00,0x00,0x00,0x00,0x00,0x00,0x00,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0x00,
	0x00,0x00,0x00,0x80,0xC0,0xE0,0x60,0x70,0x30,0x30,0x30,0x70,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0x00,
	0x00,0x00,0xFC,0xFF,0x03,0x00,0x00,0x00,0x00,0x00,0x00,0x00,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0x00,
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	0x00,0x00,0x00,0x00,0x00,0x00,0x00,0x00,0x00,0x00,0x00,0x00,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0x00	
};

int main(void)
{
	char Text[25];
	int8_t x,y;
	int8_t i,keyin;
	int8_t hit;
	int8_t score, life;

	int8_t bird_x, bird_y;
	int8_t Tower_Type[3], Tower_x[3], Tower_y[3];
	int8_t Tower_Speed, Type_no;
	
	SYS_Init();
	  
	init_LCD();
	clear_LCD();
  OpenKeyPad();// initialize 3x3 keypad
	draw_LCD(GameTitle); // draw Game Title scene
	for (i=0;i<3;i++) CLK_SysTickDelay(1000000);
	clear_LCD();

	printS_5x7( 0, 0,"LCD Game - FlappyBird");	
	printS_5x7(20,16,"Keypad 3x3    ");	
	printS_5x7(20,24,"2 : move up   ");
	printS_5x7(20,32,"8 : move down ");		
	printS_5x7(20,40,"4 : move left ");
	printS_5x7(20,48,"6 : move right");	
	printS_5x7(10,56,"Press Any Key To Start!");	
	
	keyin=ScanKey();
  while(keyin==0) { keyin=ScanKey();}
	clear_LCD();
	
  // set initial location of bus & its speed
  Tower_Type[0]=1; Tower_x[0]=32;
	Tower_Type[1]=5; Tower_x[1]=64;
	Tower_Type[2]=3; Tower_x[2]=96;
	Tower_Speed=1;   Type_no=0;
	// set initial location of bird
	bird_x=0; bird_y=24;	
	score=0; life=3; hit=0;

	while(1) {
	  // Display Score & Life
	  sprintf(Text,"SCORE %3d        LIFE %3d",score, life);	
	  x=0; y=0; printS_5x7(x,y,Text);			
		if (hit==0)
	  {
		  // Display Ojbects : draw foreground color to display object
		  for (i=0;i<3;i++) {
				switch(Tower_Type[i]) {
					case 1: Tower_y[i]=64-16;
						      draw_Bmp16x16(Tower_x[i], Tower_y[i],FG_COLOR,BG_COLOR, bmp_TowerD4);
					        break;
					case 2: Tower_y[i]=64-24;
						      draw_Bmp16x24(Tower_x[i], Tower_y[i],FG_COLOR,BG_COLOR, bmp_TowerD3);
					        break;
					case 3: Tower_y[i]=64-32;
						      draw_Bmp16x32(Tower_x[i], Tower_y[i],FG_COLOR,BG_COLOR, bmp_TowerD2);
					        break;
					case 4: Tower_y[i]=64-16;
						      draw_Bmp16x40(Tower_x[i], Tower_y[i],FG_COLOR,BG_COLOR, bmp_TowerD1);
					        break;
					case 5: Tower_y[i]=0;
						      draw_Bmp16x16(Tower_x[i], Tower_y[i],FG_COLOR,BG_COLOR, bmp_TowerU1);
					        break;
					case 6: Tower_y[i]=0;
						      draw_Bmp16x24(Tower_x[i], Tower_y[i],FG_COLOR,BG_COLOR, bmp_TowerU2);
					        break;
					case 7: Tower_y[i]=0;
						      draw_Bmp16x32(Tower_x[i], Tower_y[i],FG_COLOR,BG_COLOR, bmp_TowerU3);
					        break;
					case 8: Tower_y[i]=0;
						      draw_Bmp16x40(Tower_x[i], Tower_y[i],FG_COLOR,BG_COLOR, bmp_TowerU4);
					        break;
          default:break;
				}					
			}
	    draw_Bmp16x16(bird_x, bird_y, FG_COLOR,BG_COLOR, bmp_Bird);
	    // Display Score & Life
	    sprintf(Text,"SCORE %3d        LIFE %3d",score, life);	
	    x=0; y=0; printS_5x7(x,y,Text);			
		
		  // Delay for Vision
		  CLK_SysTickDelay(5000);
		
		  // Erase Ojbects : draw background color at the ojbect location
		  for (i=0;i<3;i++) {
				switch(Tower_Type[i]) {
					case 1: Tower_y[i]=64-16;
						      draw_Bmp16x16(Tower_x[i], Tower_y[i],BG_COLOR,BG_COLOR, bmp_TowerD4);
					        break;
					case 2: Tower_y[i]=64-24;
						      draw_Bmp16x24(Tower_x[i], Tower_y[i],BG_COLOR,BG_COLOR, bmp_TowerD3);
					        break;
					case 3: Tower_y[i]=64-32;
						      draw_Bmp16x32(Tower_x[i], Tower_y[i],BG_COLOR,BG_COLOR, bmp_TowerD2);
					        break;
					case 4: Tower_y[i]=64-40;
						      draw_Bmp16x40(Tower_x[i], Tower_y[i],BG_COLOR,BG_COLOR, bmp_TowerD1);
					        break;
					case 5: Tower_y[i]=0;
						      draw_Bmp16x16(Tower_x[i], Tower_y[i],BG_COLOR,BG_COLOR, bmp_TowerU1);
					        break;
					case 6: Tower_y[i]=0;
						      draw_Bmp16x24(Tower_x[i], Tower_y[i],BG_COLOR,BG_COLOR, bmp_TowerU2);
					        break;
					case 7: Tower_y[i]=0;
						      draw_Bmp16x32(Tower_x[i], Tower_y[i],BG_COLOR,BG_COLOR, bmp_TowerU3);
					        break;
					case 8: Tower_y[i]=0;
						      draw_Bmp16x40(Tower_x[i], Tower_y[i],BG_COLOR,BG_COLOR, bmp_TowerU4);
					        break;
          default:break;
				}					
			}
	    draw_Bmp16x16(bird_x, bird_y, BG_COLOR,BG_COLOR, bmp_Bird); 		
		
	    // Object Move by changing its x,y
		
		  keyin=ScanKey(); // get keypad
		  switch(keyin) {  // to increment bird's x,y
			case 2: bird_y--; break;
			case 4: bird_x--; break;
			case 6: bird_x++; break;
			case 8: bird_y++; break;
			default:          break;
		  }
	    //inc/dec Bus x for moving horizontally
			for (i=0; i<3; i++) 
		     Tower_x[i] -= Tower_Speed;
	 			
	    // Boundary Check : if >max, set to min; if <min, set to max;
			for (i=0; i<3; i++)
			   if (Tower_x[i]<0) {					 
					 Type_no++;
					 if (Type_no==4) Type_no=0; // exclude Tower 16x40					 
					 if (Type_no>8) Type_no=Type_no-8;
					 Tower_Type[i]=Type_no;
					 Tower_x[i]=LCD_Xmax-16;
				 }
		
		  if (bird_x>(LCD_Xmax-Bird_Xsize))	bird_x=0;
      if (bird_x<0)                     bird_x=LCD_Xmax-Bird_Xsize;
		  if (bird_y>(LCD_Ymax-Bird_Ysize))	bird_y=0;
      if (bird_y<0)                     bird_y=LCD_Ymax-Bird_Ysize;
				
	    // Collision Detection : check if bird hit by Bus
			for (i=0; i<3; i++) 
				if (bird_x+Bird_Xsize >Tower_x[i] && bird_x<Tower_x[i]+Tower_Xsize)
			     if (bird_y+Bird_Ysize>=Tower_y[i] && bird_y<Tower_y[i]+(Tower_Type[i]%4)*8) {
						 hit=1;
						 Tower_Type[i]=0;
					 }
		}	else { // hit
			hit=0;
			life--;
		  if (life>0) {
				  x=0; y=0;	 printS_5x7(x,y,"    *** Try Again ***    ");			
			    printS_5x7( 0,56,"Press Any Key To Start!"); }
			else {
					sprintf(Text,"SCORE %3d000     LIFE %3d",score, life);
					x=0; y=0;  printS_5x7(x,y,Text);
				  x=0; y=32; printS_5x7(x,y,"  ===== GAME OVER =====  ");				
				  score=0; life=3;
			} 
			CLK_SysTickDelay(1000000);
	    keyin=0;
      while(keyin==0) { keyin=ScanKey();}
			clear_LCD();
			bird_x=0; bird_y=24; 				
		}	// if-else
	} // which(1)
}
