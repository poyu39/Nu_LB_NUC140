#include <stdio.h>
#include "NUC100Series.h"
#include "MCU_init.h"
#include "SYS_init.h"
#include "NewLCD.h"
#include "Seven_Segment.h"

#define GREENMAN_MAP_WIDTH 304
#define GREENMAN_MAP_HEIGHT 16

uint8_t green_man_16_bin[] = {
	0, 0, 0, 0, 0, 0, 0, 0, 0, 0, 0, 0,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 0, 
	0, 0, 0, 0, 0, 1, 1, 0, 0, 0, 0, 0,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 0, 
	0, 0, 0, 0, 1, 1, 1, 1, 0, 0, 0, 0,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 0, 
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	0, 0, 0, 0, 0, 0, 0, 0, 0, 0, 0, 0,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 0, 
};

volatile uint8_t timer0_100ms, timer0_sec;
volatile uint8_t frame;

void Buzz(void) {
    PB11 = 0;
    CLK_SysTickDelay(100000);
    PB11 = 1;
    CLK_SysTickDelay(100000);
}

void init_rgb(void) {
	GPIO_SetMode(PB, (BIT12 | BIT13 | BIT14), GPIO_MODE_OUTPUT);
	PA12 = 1; PA13 = 1; PA14 = 1;
}

void control_rgb(uint8_t r, uint8_t g, uint8_t b) {
	PA12 = r; PA13 = g; PA14 = b;
}

void draw_green_man(uint8_t frame) {
	int i, j;
	for (i = 0; i < GREENMAN_MAP_HEIGHT; i++) {
		for (j = 0; j < GREENMAN_MAP_HEIGHT; j++) {
			if (green_man_16_bin[j + i * GREENMAN_MAP_WIDTH + frame * 16] == 1) {
				draw_rectangle_in_buffer(j+j*2+32, i+(i*2)+8, j+(j+1)*2+32, i+(i+1)*2+8, FG_COLOR, BG_COLOR, 1);
			}
		}
	}
}

void TMR1_IRQHandler(void) {
    CloseSevenSegment();
	clear_lcd_buffer();
    if (timer0_sec % 14 < 9) {
        draw_green_man(frame);
		frame++;
		frame %= 18;
        control_rgb(1, 0, 1);
        ShowSevenSegment(0, 9 - timer0_sec % 14);
    } else if (timer0_sec % 14 >= 9 && timer0_sec % 14 < 14) {
		draw_green_man(18);
        control_rgb(1, 1, 0);
        ShowSevenSegment(3, 14 - timer0_sec % 14);
    }
	show_lcd_buffer();
    timer0_100ms++;
	if (timer0_100ms % 10 == 0) {
		timer0_sec++;
		timer0_sec %= 60;
	}
    TIMER_ClearIntFlag(TIMER1);
}

void Init_Timer1(void) {
    TIMER_Open(TIMER1, TMR1_OPERATING_MODE, TMR1_OPERATING_FREQ);
    TIMER_EnableInt(TIMER1);
    NVIC_EnableIRQ(TMR1_IRQn);
    TIMER_Start(TIMER1);
}

void EINT1_IRQHandler(void) {
    GPIO_CLR_INT_FLAG(PB, BIT15);
    timer0_sec = 9;
    Buzz();
}

void Init_EXTINT(void) {
    GPIO_SetMode(PB, BIT15, GPIO_MODE_INPUT);
    GPIO_EnableEINT1(PB, 15, GPIO_INT_RISING);
    NVIC_EnableIRQ(EINT1_IRQn);

    GPIO_SET_DEBOUNCE_TIME(GPIO_DBCLKSRC_LIRC, GPIO_DBCLKSEL_64);
    GPIO_ENABLE_DEBOUNCE(PB, BIT15);
}

int main(void) {
	int i;
    SYS_Init();
	init_rgb();
	init_lcd();
	clear_lcd_buffer();
    OpenSevenSegment();
    Init_EXTINT();
    Init_Timer1();

    while (TRUE);
}
